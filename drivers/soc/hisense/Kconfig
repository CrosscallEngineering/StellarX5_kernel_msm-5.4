## drivers/soc/hisense/Kconfig
```kconfig
source "drivers/soc/hisense/base/Kconfig"

source "drivers/soc/hisense/pm/Kconfig"

source "drivers/soc/hisense/mm/Kconfig"

source "drivers/soc/hisense/usb/Kconfig"

source "drivers/soc/hisense/pmic/Kconfig"

source "drivers/soc/hisense/debug/Kconfig"

source "drivers/soc/hisense/efuse/Kconfig"

source "drivers/soc/hisense/security/Kconfig"

source "drivers/soc/hisense/sales_name/Kconfig"

source "drivers/soc/hisense/abnormal_stats/Kconfig"

source "drivers/soc/hisense/rs_recorder/Kconfig"

source "drivers/soc/hisense/misc/Kconfig"

source "drivers/soc/hisense/audio/Kconfig"

source "drivers/soc/hisense/subsystem/Kconfig"

source "drivers/soc/hisense/sensor/Kconfig"
```

## drivers/soc/hisense/abnormal_stats/Kconfig
```kconfig
config SUBSYS_ERR_WARM_RESET
	bool "current platform support warm reset"
	depends on SUBSYS_ERR_REPORT
	default n
	help
	  If use platform support warm reset, then say Y,
	  or N.

config ABNORMAL_STATS_SAVE_FILE
	bool "save abnormal reboot reason string to file"
	depends on ABNORMAL_STATS
	default n
	help
	  If set Y, save abnormal reboot reason to /kdebuginfo/rs_recorder/reboot_stats
```

## drivers/soc/hisense/base/Kconfig
```kconfig
comment "Hisense product Infomation"
config MACH_HISENSE_SMARTPHONE
	tristate "HISENSE SMARTPHONE"
	default n
	help
	  Support for the hisense samrtphone board.

config HISENSE_VENDOR_NAME
	depends on MACH_HISENSE_SMARTPHONE
	string "Hisense vendor info"
	default ""
	help
	  The vendor name of product.

config HISENSE_PRODUCT_NAME
	depends on MACH_HISENSE_SMARTPHONE
	string "Hisense product info"
	default ""
	help
	  The product name.

config HISENSE_PLATFORM_NAME
	depends on MACH_HISENSE_SMARTPHONE
	string "Hisense platform info"
	default ""
	help
	  The platform name.

config HISENSE_PRODUCT_DEVINFO
	depends on MACH_HISENSE_SMARTPHONE
	tristate "device info register of product"
	help
	  Provide a methed to register the peripheral device
	  infomation of product.

config HISENSE_DEBUG_CTRL
	bool "Hisense debug method"
	depends on HISENSE_PRODUCT_DEVINFO
	default n
	help
	  Say Y when you need debug your device.

config HISENSE_BOOT_FLOW
	bool "Hisense boot flow"
	depends on MACH_HISENSE_SMARTPHONE
	default n
	help
	  Provide the special boot flow.
```

## drivers/soc/hisense/pmic/Kconfig
```kconfig
config HISENSE_CHARGE_FG_FUNCTION
	bool "Add the hisense charge/fg driver"
	depends on MACH_HISENSE_SMARTPHONE
	default n
	help
	  Add the hisense charge function. Such as
	  smb-charger,fg and so on.

config HISENSE_WEAK_CHARGER
	bool "Add the WEAK charger or line support"
	depends on HISENSE_CHARGE_FG_FUNCTION
	default n
	help
	  Add weak charger or line support.

config HISENSE_TYPEC_OTG_CONTROL_FUNCTION
	bool "type c OTG control"
	depends on MACH_HISENSE_SMARTPHONE
	default n
	help
	 y to use type c OTG control.
	 n not using type c OTG control.

config HISENSE_BATTERY_THERM_NTC_10K
	bool "using battery thermal 10k ntc"
	depends on MACH_HISENSE_SMARTPHONE
	default n
	help
	 y to use 10k ntc.
	 n to use default 100k ntc.
```

## drivers/soc/hisense/sensor/Kconfig
```kconfig
#
# hisense sensors device configuration
#
config SENSORS
	bool "Sensors Class Support"
	help
	  This option enables the sensor sysfs class in /sys/class/sensors.
	  You'll need this to do anything useful with sensorss. If unsure, say N.

menu "Hisense sensors device support"
	depends on SENSORS

config HS_SNS_ACC
	bool "Provide Accelerometer Device Support"
	default n
	depends on SENSORS
	help
	  Say Y here, a list of availible accelerometer chips shall be shown.
	  Then you can select one or more chip for one project.

choice
	prompt "Choice Acc sensor plant side"
	default HS_SNS_ADSP_ACC
	depends on HS_SNS_ACC

config HS_SNS_AP_ACC
	bool "The Acc sensor plant in the AP side"

config HS_SNS_ADSP_ACC
	bool "The Acc sensor plant in the ADSP side"
	select HS_SNS_STEP

endchoice

config ACC_SENSOR_VENDOR
	string "ACC SENSOR VENDOR"
	depends on HS_SNS_ADSP_ACC
	default ""
	help
		Add vendor info for ACC sensor.

config ACC_SENSOR_TYPE
	string "ACC SENSOR TYPE"
	depends on HS_SNS_ADSP_ACC
	default ""
	help
		Add type info for ACC sensor.

config HS_SNS_MAG
	bool "Provide Magnetic Device Support"
	default n
	depends on HS_SNS_ACC
	help
		Say Y here, a list of availible Magnetic chips shall be shown.
		Then you can select one or more chip for one project.
	
choice
	prompt "Choice Mag sensor plant side"
	default HS_SNS_ADSP_MAG
	depends on HS_SNS_MAG

config HS_SNS_AP_MAG
	bool "The Mag sensor plant in the AP side"

config HS_SNS_ADSP_MAG
	bool "The Mag sensor plant in the ADSP side"

endchoice

config MAG_SENSOR_VENDOR
	string "MAG SENSOR VENDOR"
	depends on HS_SNS_ADSP_MAG
	default ""
	help
		Add vendor info for MAG sensor.
		This option only used for ADSP.

config MAG_SENSOR_TYPE
	string "MAG SENSOR TYPE"
	depends on HS_SNS_ADSP_MAG
	default ""
	help
		Add type info for MAG sensor.
		This option only used for ADSP.

config HS_SNS_GYRO
	bool "Provide Gyroscope Device Support"
	default n
	depends on HS_SNS_ACC
	help
	  Say Y here, a list of availible Gyroscope chips shall be shown.
	  Then you can select one or more chip for one project.
	
choice
	prompt "Choice Gyro sensor plant side"
	default HS_SNS_ADSP_GYRO
	depends on HS_SNS_GYRO

config HS_SNS_AP_GYRO
	bool "The Mag sensor plant in the AP side"

config HS_SNS_ADSP_GYRO
	bool "The Mag sensor plant in the ADSP side"

endchoice

config GYRO_SENSOR_VENDOR
	string "GYRO SENSOR VENDOR"
	depends on HS_SNS_ADSP_GYRO
	default ""
	help
		Add vendor info for GYRO sensor.
		This option only used for ADSP.

config GYRO_SENSOR_TYPE
	string "GYRO SENSOR TYPE"
	depends on HS_SNS_ADSP_GYRO
	default ""
	help
		Add type info for GYRO sensor.
		This option only used for ADSP.

config HS_SNS_ALS_PS
	bool "Provide Optical Sensor Device Support"
	default n
	depends on SENSORS
	help
		Say Y here, a list of availible Optical Sensor chips shall be shown.

config HS_SNS_ADSP_ALSPS
	bool "Provide Optical Sensor Device Support"
	default n
	depends on SENSORS
	help
		Say Y here, a list of availible Optical Sensor chips shall be shown.

config ALSP_SENSOR_VENDOR
	string "ALSPS SENSOR VENDOR"
	depends on HS_SNS_ADSP_ALSPS
	default ""
	help
		Add vendor info for ALSPS sensor.
		This option only used for ADSP.

config ALSP_SENSOR_TYPE
	string "ALSP SENSOR TYPE"
	depends on HS_SNS_ADSP_ALSPS
	default ""
	help
		Add type info for ALSPS sensor.
		This option only used for ADSP.

endmenu
```

## drivers/soc/hisense/subsystem/Kconfig
```kconfig
config HISENSE_RESTART_MODEM
	bool "force restart modem subsystem"
	depends on HISENSE_DEBUG_CTRL
	default n
	help
	  Provide a node for control to restart modem
```

## drivers/soc/hisense/usb/Kconfig
```kconfig
config USBADB_CUSTOM_KEY
	bool "custom the adb backdoor key"
	depends on HISENSE_ADB_BACKDOOR
	default n
	help
	  Implement Change USB adb backdoor key
```
